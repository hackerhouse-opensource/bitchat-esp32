## boards/waveshare/waveshare_esp32c6_147/board.yml
```yaml
board:
  name: waveshare_esp32c6_147
  vendor: waveshare
  socs:
    - name: esp32c6_wroom_n4
```

## boards/waveshare/waveshare_esp32c6_147/waveshare_esp32c6_147_defconfig
```kconfig
CONFIG_SOC_SERIES_ESP32C6=y
CONFIG_SOC_ESP32C6_WROOM_N4=y
CONFIG_BOARD_WAVESHARE_ESP32C6_147=y

CONFIG_MAIN_STACK_SIZE=2048

CONFIG_CONSOLE=y
CONFIG_SERIAL=y
CONFIG_UART_CONSOLE=y
CONFIG_GPIO=y
```

## boards/waveshare_esp32c6_147_defconfig
```kconfig
# Waveshare ESP32-C6 1.47" Display Board Configuration

CONFIG_SOC_SERIES_ESP32C6=y
CONFIG_SOC_ESP32C6_WROOM_N4=y
CONFIG_BOARD_WAVESHARE_ESP32C6_147=y

CONFIG_MAIN_STACK_SIZE=2048
CONFIG_SYS_CLOCK_HW_CYCLES_PER_SEC=16000000

CONFIG_CONSOLE=y
CONFIG_SERIAL=y
CONFIG_UART_CONSOLE=y

CONFIG_GPIO=y
CONFIG_SPI=y
```
