#include <zephyr/dt-bindings/pinctrl/esp32c6-pinctrl.h>
#include <dt-bindings/pinctrl/esp32-pinctrl-common.h>

&pinctrl {
	uart0_default: uart0_default {
		group1 {
			pinmux = <UART0_TX_GPIO16>;
		};
		group2 {
			pinmux = <UART0_RX_GPIO17>;
			bias-pull-up;
		};
	};
};
